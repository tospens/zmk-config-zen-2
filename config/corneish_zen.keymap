#include <behaviors.dtsi>
#include <dt-bindings/zmk/keys.h>
#include <dt-bindings/zmk/bt.h>

#include "../zmk-nodefree-config/helper.h"
#include "../zmk-nodefree-config/keypos_def/keypos_36keys.h"
#include "../zmk-nodefree-config/international_chars/danish.dtsi"

/ { chosen { zmk,matrix_transform = &five_column_transform; }; };

/* Layer alias */

#define BASE 0
#define NAV 1
#define NUM 2
#define SYM 3
#define FN 4
#define SYS 5
#define MOUSE 6

#include "combos.dtsi"
#include "mouse.dtsi"

ZMK_CONDITIONAL_LAYER(FN NUM, SYS)    // FN + NUM --> SYS

/* Navigation keys and shortcuts */

&mt {
    flavor = "tap-preferred";
    tapping-term-ms = <220>;
    quick-tap-ms = <220>;              // repeat on tap-into-hold
    hold-trigger-key-positions = <0>;  // tap on interrupt
};

#define NAV_LEFT  &mt HOME     LEFT    // tap: left  | long-tap: beginning of line
#define NAV_RIGHT &mt END      RIGHT   // tap: right | long-tap: end       of line
#define NAV_UP    &mt LC(HOME) UP      // tap: up    | long-tap: beginning of document
#define NAV_DOWN  &mt LC(END)  DOWN    // tap: down  | long-tap: end       of document
#define NAV_BSPC  &mt LC(BSPC) BSPC    // tap: bspc  | long-tap: delete word backward
#define NAV_DEL   &mt LC(DEL)  DEL     // tap: del   | long-tap: delete word forward

#define XXX &none
#define ___ &trans

#define CANCEL      &kp K_CANCEL             // cancel caps-word and num-word
#define DSK_PREV    &hmr RSHFT LG(LC(LEFT))  // previous desktop
#define DSK_NEXT    &hmr LALT LG(LC(RIGHT))  // next     desktop
#define VOL_DOWN    &hmr LCTRL C_VOL_DN

// Clipboard keycodes.
#define U_RDO LC(Y)
#define U_PST LC(V)
#define U_CPY LC(C)
#define U_CUT LC(X)
#define U_UND LC(Z)

// Window management keycodes.
#define U_SLFT LG(LS(LEFT))
//#define U_WLFT LG(LEFT) // Replaced by macros
//#define U_WNUP LG(UP)
//#define U_WRGT LG(RIGHT)
#define U_SRGT LG(LS(RIGHT))        
#define U_DRGT LG(LC(RIGHT))
#define U_DLFT LG(LC(LEFT))
#define U_DSHW LG(TAB)

// Misc
#define U_PSCR LC(PSCRN)

/* Settings */

#define QUICK_TAP_MS 175

&sk {  // sticky-key config
    release-after-ms = <600>;  // release after 0.6s
    quick-release;             // no double capitalization when rolling keys
};

&sl {  // sticky-layer config
    ignore-modifiers;
};

&lt {  // layer-tap config
    flavor = "balanced";
    tapping-term-ms = <200>;
    quick-tap-ms = <QUICK_TAP_MS>;
};

&caps_word {
        /delete-property/ ignore-modifiers;
};

&num_word {  // num-word, requires PR #1441
    layers = <NUM>;
};

/* Homerow mods */

#define KEYS_L LT0 LT1 LT2 LT3 LT4 LM0 LM1 LM2 LM3 LM4 LB0 LB1 LB2 LB3 LB4  // left-hand keys
#define KEYS_R RT0 RT1 RT2 RT3 RT4 RM0 RM1 RM2 RM3 RM4 RB0 RB1 RB2 RB3 RB4  // right-hand keys
#define THUMBS LH2 LH1 LH0 RH0 RH1 RH2                                      // thumb keys

ZMK_BEHAVIOR(hml, hold_tap,  // left-hand HRMs
    flavor = "balanced";
    tapping-term-ms = <280>;
    quick-tap-ms = <QUICK_TAP_MS>;
    global-quick-tap-ms = <150>;        // requires PR #1387
    bindings = <&kp>, <&kp>;
    hold-trigger-key-positions = <KEYS_R THUMBS>;
    hold-trigger-on-release;            // requires PR #1423
)

ZMK_BEHAVIOR(hmr, hold_tap,  // right-hand HRMs
    flavor = "balanced";
    tapping-term-ms = <280>;
    quick-tap-ms = <QUICK_TAP_MS>;
    global-quick-tap-ms = <150>;        // requires PR #1387
    bindings = <&kp>, <&kp>;
    hold-trigger-key-positions = <KEYS_L THUMBS>;
    hold-trigger-on-release;            // requires PR #1423
)

/* Custom behaviors */

ZMK_BEHAVIOR(cblck, macro,
    wait-ms = <10>;
    tap-ms = <20>;
    bindings = <&kp GRAVE &kp GRAVE &kp GRAVE>;
)
ZMK_BEHAVIOR(dblbrc, macro,
    wait-ms = <10>;
    tap-ms = <20>;
    bindings = <&kp LBRC &kp RBRC>, <&kp LEFT>;
)
ZMK_BEHAVIOR(dblpar, macro,
    wait-ms = <10>;
    tap-ms = <20>;
    bindings = <&kp LPAR &kp RPAR>, <&kp LEFT>;
)
ZMK_BEHAVIOR(dblbkt, macro,
    wait-ms = <10>;
    tap-ms = <20>;
    bindings = <&kp LBKT &kp RBKT>, <&kp LEFT>;
)
ZMK_BEHAVIOR(winleft, macro,
    wait-ms = <10>;
    tap-ms = <20>;
    bindings 
    = <&macro_press   &kp LGUI>
    , <&macro_tap     &kp LEFT>
    , <&macro_release &kp LGUI>
    ;
)
ZMK_BEHAVIOR(winrght, macro,
    wait-ms = <10>;
    tap-ms = <20>;
    bindings 
    = <&macro_press   &kp LGUI>
    , <&macro_tap     &kp RIGHT>
    , <&macro_release &kp LGUI>
    ;
)
ZMK_BEHAVIOR(winup, macro,
    wait-ms = <10>;
    tap-ms = <20>;
    bindings 
    = <&macro_press   &kp LGUI>
    , <&macro_tap     &kp UP>
    , <&macro_release &kp LGUI>
    ;
)
ZMK_BEHAVIOR(selwordstart, macro,
    wait-ms = <10>;
    tap-ms = <20>;
    bindings
    = <&kt LCTRL>, <&kp RIGHT>, <&kp LEFT>, <&kt LSHFT>, <&kp RIGHT>;
)
ZMK_BEHAVIOR(selwordend, macro,
    wait-ms = <10>;
    tap-ms = <20>;
    bindings
    = <&kt LCTRL>, <&kt LSHFT>;
)
ZMK_BEHAVIOR(selword, tri_state,
    bindings = <&selwordstart>, <NAV_RIGHT>, <&selwordend>;
    ignored-key-positions = <RM1>;
)
ZMK_BEHAVIOR(selline, macro,
    wait-ms = <10>;
    tap-ms = <20>;
    bindings
    = <&macro_tap     &kp HOME>
    , <&macro_press   &kp LSHFT>
    , <&macro_tap     &kp END>
    , <&macro_release &kp LSHFT>
    ;
)
ZMK_BEHAVIOR(joinln, macro,
    wait-ms = <10>;
    tap-ms = <20>;
    bindings
    = <&macro_tap     &kp END>
    , <&macro_tap     &kp DEL>
    , <&macro_press   &kp LCTRL>
    , <&macro_tap     &kp RIGHT>
    , <&macro_tap     &kp LEFT>
    , <&macro_press   &kp LSHFT>
    , <&macro_tap     &kp LEFT>
    , <&macro_tap     &kp RIGHT>
    , <&macro_release &kp LSHFT &kp LCTRL>
    , <&macro_tap     &kp SPACE>
    ;
)

// Windows sleep key
ZMK_BEHAVIOR(win_sleep, macro,
    wait-ms = <100>;
    tap-ms = <5>;
    bindings = <&kp LG(X) &kp U &kp S>;
)

// tap: sticky-shift | lshft + tap: caps-word | hold: shift
ZMK_BEHAVIOR(ss_cw, mod_morph,
    bindings = <&sk LSHFT>, <&caps_word>;
    mods = <(MOD_LSFT)>;
)

// tap: backspace | lshft + tap: delete | rshft + tap: shift-delete | hold: fn layer
ZMK_BEHAVIOR(bs_del, mod_morph,
    bindings = <&kp BSPC>, <&kp DEL>;
    mods = <(MOD_LSFT|MOD_RSFT)>;
    keep-mods = <MOD_RSFT>;
)
ZMK_BEHAVIOR(lt_bspc, hold_tap,
    flavor = "balanced";
    tapping-term-ms = <200>;
    quick-tap-ms = <QUICK_TAP_MS>;
    bindings = <&mo>, <&bs_del>;
)

// tap: num-word | double-tap: sticky fun-layer | hold: num-layer
ZMK_BEHAVIOR(num_fun_dance, tap_dance,
    tapping-term-ms = <200>;
    bindings = <&num_word>, <&sl FN>;
)
ZMK_BEHAVIOR(num_layer_word, hold_tap,
    flavor = "balanced";
    tapping-term-ms = <200>;
    quick-tap-ms = <QUICK_TAP_MS>;
    bindings = <&mo>, <&num_fun_dance>;
)
#define NUM_WORD &num_layer_word NUM 0

// tap: space | space + shift: dot -> space -> sticky shift | hold: activate layer
ZMK_BEHAVIOR(dot_spc, macro,
    wait-ms = <0>;
    tap-ms = <5>;
    bindings = <&kp DOT &kp SPACE &sk LSHFT>;
)
ZMK_BEHAVIOR(spc_morph, mod_morph,
    bindings = <&kp SPACE>, <&dot_spc>;
    mods = <(MOD_LSFT|MOD_RSFT)>;
)
ZMK_BEHAVIOR(lt_spc, hold_tap,
    flavor = "balanced";
    tapping-term-ms = <200>;
    quick-tap-ms = <QUICK_TAP_MS>;
    bindings = <&mo>, <&spc_morph>;
)

// Swapper, requires PR #1366
ZMK_BEHAVIOR(swap, tri_state,
    bindings = <&kt LALT>, <&kp TAB>, <&kt LALT>;
    ignored-key-positions = <LT2>;
)
ZMK_BEHAVIOR(tabswap, tri_state,
    bindings = <&kt LCTRL>, <&kp TAB>, <&kt LCTRL>;
    ignored-key-positions = <LT2>;
)

/* Keymap */

ZMK_LAYER(QWERTY,
//╭─────────────┬─────────────┬─────────────┬─────────────┬─────────────╮ ╭─────────────┬─────────────┬─────────────┬─────────────┬─────────────╮
    &kp Q         &kp W         &kp E         &kp R         &kp T           &kp Y         &kp U         &kp I         &kp O         &kp P           
//├─────────────┼─────────────┼─────────────┼─────────────┼─────────────┤ ├─────────────┼─────────────┼─────────────┼─────────────┼─────────────┤  
    &hml LGUI A   &hml LALT S   &hml LCTRL D  &hml LSHFT F  &kp G           &kp H         &hmr RSHFT J  &hmr LCTRL K  &hmr LALT L   &hmr LGUI SEMI 
//├─────────────┼─────────────┼─────────────┼─────────────┼─────────────┤ ├─────────────┼─────────────┼─────────────┼─────────────┼─────────────┤
    &kp Z         &kp X         &kp C         &kp V         &kp B           &kp N         &kp M         &kp COMMA     &kp DOT       &kp FSLH        
//╰─────────────┼─────────────┴─────────────┼─────────────┼─────────────┤ ├─────────────┼─────────────┼─────────────┴───────────────────────────╯  
                                &lt MOUSE ESC  &lt_spc NAV 0 &lt_bspc FN 0   NUM_WORD      &ss_cw        &lt SYM ENTER
//                            ╰─────────────┴─────────────┴─────────────╯ ╰─────────────┴─────────────┴─────────────╯
)

ZMK_LAYER(nav,
//╭─────────────┬─────────────┬─────────────┬─────────────┬─────────────╮ ╭─────────────┬─────────────┬─────────────┬─────────────┬─────────────╮
    &kp U_UND     &kp U_RDO     &kp LS(TAB)   &swap         &tabswap        &selline      NAV_BSPC      &kp ENTER     NAV_DEL       ___
//├─────────────┼─────────────┼─────────────┼─────────────┼─────────────┤ ├─────────────┼─────────────┼─────────────┼─────────────┼─────────────┤
    &sk LGUI      &sk LALT      &sk LCTRL     &sk LSHFT     &kp U_PSCR      &selword      NAV_LEFT      NAV_DOWN      NAV_UP        NAV_RIGHT
//├─────────────┼─────────────┼─────────────┼─────────────┼─────────────┤ ├─────────────┼─────────────┼─────────────┼─────────────┼─────────────┤
    &kp U_SLFT    &winleft      &winup        &winrght      &kp U_SRGT      &joinln       &kp TAB       &kp PG_DN     &kp PG_UP     &kp END
//╰─────────────┼─────────────┴─────────────┼─────────────┼─────────────┤ ├─────────────┼─────────────┼─────────────┴───────────────────────────╯
                          	    ___           ___           ___             ___           CANCEL        ___
//                            ╰─────────────┴─────────────┴─────────────╯ ╰─────────────┴─────────────┴─────────────╯
)

ZMK_LAYER(num,
//╭─────────────┬─────────────┬─────────────┬─────────────┬─────────────╮ ╭─────────────┬─────────────┬─────────────┬─────────────┬─────────────╮
    ___           &kp N7        &kp N8        &kp N9        ___             ___           ___           ___           ___           ___
//├─────────────┼─────────────┼─────────────┼─────────────┼─────────────┤ ├─────────────┼─────────────┼─────────────┼─────────────┼─────────────┤
    &hml LGUI N0  &hml LALT N4  &hml LCTRL N5 &hml LSHFT N6 ___             ___           ___           ___           ___           ___
//├─────────────┼─────────────┼─────────────┼─────────────┼─────────────┤ ├─────────────┼─────────────┼─────────────┼─────────────┼─────────────┤
    ___           &kp N1        &kp N2        &kp N3        ___             ___           ___           ___           ___           ___
//╰─────────────┼─────────────┴─────────────┼─────────────┼─────────────┤ ├─────────────┼─────────────┼─────────────┴───────────────────────────╯
                                ___           ___           ___             ___           ___           ___
//                            ╰─────────────┴─────────────┴─────────────╯ ╰─────────────┴─────────────┴─────────────╯
)

ZMK_LAYER(sym,
//╭─────────────┬─────────────┬─────────────┬─────────────┬─────────────╮ ╭─────────────┬─────────────┬─────────────┬─────────────┬─────────────╮
    &kp SQT       &kp LT        &kp GT        &kp DQT       &cblck          &kp GRAVE     &kp AMPS      &kp LBKT      &kp RBKT      &kp PRCNT
//├─────────────┼─────────────┼─────────────┼─────────────┼─────────────┤ ├─────────────┼─────────────┼─────────────┼─────────────┼─────────────┤
    &kp EXCL      &kp MINUS     &kp PLUS      &kp EQUAL     &kp HASH        &kp UNDER     &kp PIPE      &kp LPAR      &kp RPAR      &kp AT
//├─────────────┼─────────────┼─────────────┼─────────────┼─────────────┤ ├─────────────┼─────────────┼─────────────┼─────────────┼─────────────┤
    &kp CARET     &kp FSLH      &kp ASTRK     &kp BSLH      ___             &kp TILDE     &kp DLLR      &kp LBRC      &kp RBRC      &kp QMARK
//╰─────────────┼─────────────┴─────────────┼─────────────┼─────────────┤ ├─────────────┼─────────────┼─────────────┴───────────────────────────╯
                                &kp LALT      &kp LCTRL     ___             ___           &kp RCTRL     &kp RALT
//                            ╰─────────────┴─────────────┴─────────────╯ ╰─────────────┴─────────────┴─────────────╯
)

ZMK_LAYER(fn,
//╭─────────────┬─────────────┬─────────────┬─────────────┬─────────────╮ ╭─────────────┬─────────────┬─────────────┬─────────────┬─────────────╮
    &kp F12       &kp F7        &kp F8        &kp F9        ___             &kp PSCRN     &kp C_PREV    &kp C_VOL_UP  &kp C_NEXT    &win_sleep  
//├─────────────┼─────────────┼─────────────┼─────────────┼─────────────┤ ├─────────────┼─────────────┼─────────────┼─────────────┼─────────────┤
    &kp F11       &kp F4        &kp F5        &kp F6        ___             ___           DSK_PREV      VOL_DOWN      DSK_NEXT      ___         
//├─────────────┼─────────────┼─────────────┼─────────────┼─────────────┤ ├─────────────┼─────────────┼─────────────┼─────────────┼─────────────┤
    &kp F10       &kp F1        &kp F2        &kp F3        ___             ___           ___           ___           ___           ___        
//╰─────────────┼─────────────┴─────────────┼─────────────┼─────────────┤ ├─────────────┼─────────────┼─────────────┴───────────────────────────╯
                                ___           ___           ___             &kp C_MUTE    &kp C_PP      ___
//                            ╰─────────────┴─────────────┴─────────────╯ ╰─────────────┴─────────────┴─────────────╯
)

ZMK_LAYER(sys,
//╭─────────────┬─────────────┬─────────────┬─────────────┬─────────────╮ ╭─────────────┬─────────────┬─────────────┬─────────────┬─────────────╮
    &bt BT_SEL 0  &bt BT_SEL 1  &bt BT_SEL 2  &bt BT_SEL 3  &bt BT_SEL 4    ___           ___           ___           ___           ___
//├─────────────┼─────────────┼─────────────┼─────────────┼─────────────┤ ├─────────────┼─────────────┼─────────────┼─────────────┼─────────────┤
    ___           ___           ___           ___           ___             ___           ___           ___           ___           ___
//├─────────────┼─────────────┼─────────────┼─────────────┼─────────────┤ ├─────────────┼─────────────┼─────────────┼─────────────┼─────────────┤
    &bt BT_CLR    ___           ___           ___           ___             ___           ___           ___           ___           ___
//╰─────────────┼─────────────┴─────────────┼─────────────┼─────────────┤ ├─────────────┼─────────────┼─────────────┴───────────────────────────╯
                    	        ___           ___           ___             ___           ___           ___
//                            ╰─────────────┴─────────────┴─────────────╯ ╰─────────────┴─────────────┴─────────────╯
)

ZMK_LAYER(mouse,
//╭─────────────┬─────────────┬─────────────┬─────────────┬─────────────╮ ╭─────────────┬─────────────┬─────────────┬─────────────┬─────────────╮
    ___           ___           ___           ___           ___             ___           ___           U_MS_U        ___           ___
//├─────────────┼─────────────┼─────────────┼─────────────┼─────────────┤ ├─────────────┼─────────────┼─────────────┼─────────────┼─────────────┤
    ___           ___           ___           ___           ___             ___           U_MS_L        U_MS_D        U_MS_R        ___
//├─────────────┼─────────────┼─────────────┼─────────────┼─────────────┤ ├─────────────┼─────────────┼─────────────┼─────────────┼─────────────┤
    ___           ___           ___           ___           ___             ___           U_WH_L        U_WH_D        U_WH_U        U_WH_R
//╰─────────────┼─────────────┴─────────────┼─────────────┼─────────────┤ ├─────────────┼─────────────┼─────────────┴───────────────────────────╯
                    	        ___           ___           ___             &mkp RCLK     &mkp LCLK     &mkp MCLK
//                            ╰─────────────┴─────────────┴─────────────╯ ╰─────────────┴─────────────┴─────────────╯
)