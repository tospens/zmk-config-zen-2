## config/west.yml
```yaml
# Tospens repo with display improvements.
# manifest:
#  remotes:
#    - name: tospens
#      url-base: https://github.com/tospens
#  projects:
#    - name: zmk
#      remote: tospens
#      revision: main
#      import: app/west.yml
#  self:
#    path: config

# Urob repo https://github.com/urob/zmk
manifest:
  remotes:
    - name: urob
      url-base: https://github.com/urob
  projects:
    - name: zmk
      remote: urob
      revision: main
      import: app/west.yml
  self:
    path: config

# ZMK repo for building ZMK firmware.
# manifest:
#   remotes:
#     - name: zmkfirmware
#       url-base: https://github.com/zmkfirmware
#   projects:
#     - name: zmk
#       remote: zmkfirmware
#       revision: main
#       import: app/west.yml
#   self:
#     path: config
```
